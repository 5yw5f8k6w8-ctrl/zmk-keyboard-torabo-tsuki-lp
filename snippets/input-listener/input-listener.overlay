#include <input/processors.dtsi>

&zip_temp_layer {
    require-prior-idle-ms = <200>;
};

&pointing_listener {
    status = "okay";
    device = <&pointing_device>;
    input-processors = <&zip_temp_layer 5 600>;
};
